## config/west.yml
```yaml
manifest:
  remotes:
    - name: zmkfirmware
      url-base: https://github.com/zmkfirmware
    - name: yuchamichami
      url-base: https://github.com/yuchamichami
    - name: badjeff
      url-base: https://github.com/badjeff
    - name: nuovotaka
      url-base: https://github.com/nuovotaka
  projects:
    - name: zmk-input-processor-report-rate-limit
      remote: badjeff
      revision: main
    - name: zmk-pointing-acceleration-alpha
      remote: nuovotaka
      revision: main
    - name: zmk
      remote: zmkfirmware
      revision: main
      import: app/west.yml
  self:
    path: config
```
